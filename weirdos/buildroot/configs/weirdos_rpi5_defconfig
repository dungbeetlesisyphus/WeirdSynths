## weirdos/buildroot/configs/weirdos_rpi5_defconfig
```kconfig
# ═══════════════════════════════════════════════════════════
# WeirdOS v0.1.0 — Buildroot defconfig for Raspberry Pi 5
# A dedicated face-tracking modular synth appliance
# ═══════════════════════════════════════════════════════════

# ── Architecture ──
BR2_aarch64=y
BR2_cortex_a76=y
BR2_ARM_FP_VFPV4=y

# ── Target ──
BR2_TARGET_GENERIC_HOSTNAME="weirdos"
BR2_TARGET_GENERIC_ISSUE="Welcome to WeirdOS v0.1.0"
BR2_TARGET_GENERIC_PASSWD_SHA512=y
BR2_TARGET_GENERIC_ROOT_PASSWD="weird"
BR2_SYSTEM_BIN_SH_BASH=y

# ── Toolchain ──
BR2_TOOLCHAIN_BUILDROOT_CXX=y
BR2_TOOLCHAIN_BUILDROOT_GLIBC=y
BR2_GCC_VERSION_13_X=y
BR2_TOOLCHAIN_BUILDROOT_WCHAR=y
BR2_TOOLCHAIN_BUILDROOT_LOCALE=y

# ── Kernel ──
BR2_LINUX_KERNEL=y
BR2_LINUX_KERNEL_CUSTOM_TARBALL=y
BR2_LINUX_KERNEL_CUSTOM_TARBALL_LOCATION="https://github.com/raspberrypi/linux/archive/refs/tags/stable_20240529.tar.gz"
BR2_LINUX_KERNEL_DEFCONFIG="bcm2712"
BR2_LINUX_KERNEL_DTS_SUPPORT=y
BR2_LINUX_KERNEL_INTREE_DTS_NAME="broadcom/bcm2712-rpi-5-b"
BR2_LINUX_KERNEL_NEEDS_HOST_OPENSSL=y

# ── Kernel modules ──
# V4L2 camera, USB audio, DRM/KMS graphics
BR2_LINUX_KERNEL_CONFIG_FRAGMENT_FILES="$(BR2_EXTERNAL_WEIRDOS_PATH)/board/rpi5/kernel-fragments.cfg"

# ── Bootloader ──
BR2_TARGET_UBOOT=y
BR2_TARGET_UBOOT_BUILD_SYSTEM_KCONFIG=y
BR2_TARGET_UBOOT_CUSTOM_VERSION=y
BR2_TARGET_UBOOT_CUSTOM_VERSION_VALUE="2024.04"
BR2_TARGET_UBOOT_BOARD_DEFCONFIG="rpi_arm64"

# ── Firmware ──
BR2_PACKAGE_RPI_FIRMWARE=y
BR2_PACKAGE_RPI_FIRMWARE_VARIANT_PI=y

# ── Filesystem ──
BR2_TARGET_ROOTFS_EXT2=y
BR2_TARGET_ROOTFS_EXT2_4=y
BR2_TARGET_ROOTFS_EXT2_SIZE="4G"
BR2_ROOTFS_OVERLAY="$(BR2_EXTERNAL_WEIRDOS_PATH)/overlay"
BR2_ROOTFS_POST_BUILD_SCRIPT="$(BR2_EXTERNAL_WEIRDOS_PATH)/scripts/post-build.sh"
BR2_ROOTFS_POST_IMAGE_SCRIPT="$(BR2_EXTERNAL_WEIRDOS_PATH)/scripts/post-image.sh"

# ── SD card image ──
BR2_PACKAGE_HOST_GENIMAGE=y
BR2_PACKAGE_HOST_DOSFSTOOLS=y
BR2_PACKAGE_HOST_MTOOLS=y

# ═══════════════════════════════════════════════════
# Graphics — Wayland + wlroots (lightweight compositor)
# ═══════════════════════════════════════════════════

BR2_PACKAGE_MESA3D=y
BR2_PACKAGE_MESA3D_GALLIUM_DRIVER_V3D=y
BR2_PACKAGE_MESA3D_GALLIUM_DRIVER_VC4=y
BR2_PACKAGE_MESA3D_OPENGL_ES=y
BR2_PACKAGE_MESA3D_OPENGL_EGL=y

BR2_PACKAGE_WAYLAND=y
BR2_PACKAGE_WAYLAND_PROTOCOLS=y
BR2_PACKAGE_WESTON=y
BR2_PACKAGE_WESTON_DRM=y

BR2_PACKAGE_LIBDRM=y
BR2_PACKAGE_LIBINPUT=y

# ═══════════════════════════════════════════════════
# Audio — ALSA + JACK for low-latency
# ═══════════════════════════════════════════════════

BR2_PACKAGE_ALSA_LIB=y
BR2_PACKAGE_ALSA_LIB_MIXER=y
BR2_PACKAGE_ALSA_LIB_PCM_PLUGINS_ALL=y
BR2_PACKAGE_ALSA_UTILS=y
BR2_PACKAGE_ALSA_UTILS_APLAY=y
BR2_PACKAGE_ALSA_UTILS_AMIXER=y

BR2_PACKAGE_JACK2=y

# ═══════════════════════════════════════════════════
# Camera — V4L2 + libcamera for Pi Camera Module
# ═══════════════════════════════════════════════════

BR2_PACKAGE_LIBV4L=y
BR2_PACKAGE_LIBCAMERA=y
BR2_PACKAGE_LIBCAMERA_V4L2=y

# ═══════════════════════════════════════════════════
# Python — for the bridge script
# ═══════════════════════════════════════════════════

BR2_PACKAGE_PYTHON3=y
BR2_PACKAGE_PYTHON3_PIP=y
BR2_PACKAGE_PYTHON_NUMPY=y
BR2_PACKAGE_PYTHON_OPENCV4=y

# OpenCV with camera support
BR2_PACKAGE_OPENCV4=y
BR2_PACKAGE_OPENCV4_LIB_HIGHGUI=y
BR2_PACKAGE_OPENCV4_LIB_IMGPROC=y
BR2_PACKAGE_OPENCV4_LIB_VIDEO=y
BR2_PACKAGE_OPENCV4_LIB_VIDEOIO=y
BR2_PACKAGE_OPENCV4_WITH_V4L=y
BR2_PACKAGE_OPENCV4_WITH_FFMPEG=y

# ═══════════════════════════════════════════════════
# VCV Rack dependencies
# ═══════════════════════════════════════════════════

BR2_PACKAGE_GLEW=y
BR2_PACKAGE_GLFW=y
BR2_PACKAGE_LIBSAMPLERATE=y
BR2_PACKAGE_LIBSNDFILE=y
BR2_PACKAGE_LIBZIP=y
BR2_PACKAGE_JANSSON=y
BR2_PACKAGE_LIBCURL=y
BR2_PACKAGE_SPEEXDSP=y
BR2_PACKAGE_ZSTD=y
BR2_PACKAGE_RTAUDIO=y

# ═══════════════════════════════════════════════════
# Networking — for bridge UDP + optional remote access
# ═══════════════════════════════════════════════════

BR2_PACKAGE_DHCPCD=y
BR2_PACKAGE_DROPBEAR=y
BR2_PACKAGE_AVAHI=y
BR2_PACKAGE_AVAHI_DAEMON=y

# ═══════════════════════════════════════════════════
# System utilities
# ═══════════════════════════════════════════════════

BR2_PACKAGE_HTOP=y
BR2_PACKAGE_NANO=y
BR2_PACKAGE_USBUTILS=y
BR2_PACKAGE_V4L_UTILS=y

# ═══════════════════════════════════════════════════
# Custom packages (from BR2_EXTERNAL)
# ═══════════════════════════════════════════════════

BR2_PACKAGE_VCVRACK=y
BR2_PACKAGE_WEIRDSYNTHS=y
BR2_PACKAGE_WEIRDSYNTHS_BRIDGE=y
```

## weirdos/buildroot/external/Config.in
```kconfig
source "$BR2_EXTERNAL_WEIRDOS_PATH/package/vcvrack/Config.in"
source "$BR2_EXTERNAL_WEIRDOS_PATH/package/weirdsynths/Config.in"
source "$BR2_EXTERNAL_WEIRDOS_PATH/package/weirdsynths-bridge/Config.in"
```

## weirdos/buildroot/external/package/vcvrack/Config.in
```kconfig
config BR2_PACKAGE_VCVRACK
	bool "vcvrack"
	depends on BR2_TOOLCHAIN_HAS_THREADS_NPTL
	depends on BR2_INSTALL_LIBSTDCPP
	depends on BR2_PACKAGE_GLEW
	depends on BR2_PACKAGE_GLFW
	depends on BR2_PACKAGE_JANSSON
	depends on BR2_PACKAGE_LIBCURL
	depends on BR2_PACKAGE_LIBSAMPLERATE
	depends on BR2_PACKAGE_LIBZIP
	depends on BR2_PACKAGE_SPEEXDSP
	depends on BR2_PACKAGE_ZSTD
	help
	  VCV Rack 2 — open-source virtual Eurorack modular synthesizer.
	  https://github.com/VCVRack/Rack

	  This builds the free/open-source version of VCV Rack 2.
```

## weirdos/buildroot/external/package/weirdsynths-bridge/Config.in
```kconfig
config BR2_PACKAGE_WEIRDSYNTHS_BRIDGE
	bool "weirdsynths-bridge"
	depends on BR2_PACKAGE_PYTHON3
	depends on BR2_PACKAGE_OPENCV4
	help
	  WeirdSynths face tracking bridge — Python script that captures
	  webcam frames, runs MediaPipe face mesh, and sends tracking data
	  to VCV Rack modules via UDP.
	  https://github.com/dungbeetlesisyphus/WeirdSynths
```

## weirdos/buildroot/external/package/weirdsynths/Config.in
```kconfig
config BR2_PACKAGE_WEIRDSYNTHS
	bool "weirdsynths"
	depends on BR2_PACKAGE_VCVRACK
	help
	  WeirdSynths VCV Rack plugin — NERVE, SKULL, MIRROR, VOICE.
	  Face tracking and vocal analysis modules.
	  https://github.com/dungbeetlesisyphus/WeirdSynths
```
